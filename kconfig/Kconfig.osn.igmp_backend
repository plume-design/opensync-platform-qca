## kconfig/Kconfig.osn.igmp_backend
```kconfig
#
# QCA IGMP implementation
#
if PLATFORM_IS_QCA
orsource "../src/lib/osn/kconfig/Kconfig.osn.igmp_backend"
endif
```

## kconfig/Kconfig.osn.mld_backend
```kconfig
#
# QCA MLD implementation
#
if PLATFORM_IS_QCA
orsource "../src/lib/osn/kconfig/Kconfig.osn.mld_backend"
endif
```

## kconfig/Kconfig.osp_l2switch
```kconfig
if PLATFORM_IS_QCA
    config QCA_L2SWITCH_PORT_ISOLATION
        bool "Use L2 switch port isolation (Qualcomm only)"
        default n
        depends on OSP_L2SWITCH_NULL
        help
            When enabled, this option installs a boot time script that configures
            the internal switch to use port isolation.

            The changes that the script applies to the system allow for seamless
            configuration of native VLANs. This means that switch configuration is
            no longer necessary when the script is in effect. For this reason, this
            option requires the L2switch NULL backend as other backends may override
            configuration knobs that were set by the script.

    if QCA_L2SWITCH_PORT_ISOLATION
        config QCA_L2SWITCH_PORT_ISOLATION_CPU
            int "CPU Port"
            default 0
            help
                The L2 switch port number facing the CPU

        config QCA_L2SWITCH_PORT_ISOLATION_PORTS
            string "Isolated Interface Ports"
            default "5 4"
            help
                This is a whitespace sepeareted list representing the
                L2 switch port numbers facing ethernet interfaces.
    endif
endif
```

## kconfig/Kconfig.osp_l2switch.backend
```kconfig
if PLATFORM_IS_QCA
rsource "../src/lib/osp/kconfig/Kconfig.osp_l2switch.backend"
endif
```

## kconfig/Kconfig.platform
```kconfig
menuconfig PLATFORM_IS_QCA
    bool "Qualcomm"
    help
        Support for Qualcomm QSDK, various versions

if PLATFORM_IS_QCA

config QCA_SDK_PATH
    string "Qualcomm SDK PATH"

config QCA_RATE_HISTO_TO_EXPECTED_TPUT
    bool "Use MCS histograms to compute expected throughput phyrates"
    default y
    help
        This makes sense only for 11ac and older devices which
        originally were intended to report MCS histograms. Some of
        them couldn't be updated to deliver (reliable) expected
        throughput phyrates. Instead MCS histograms can be utilized to
        estimate them.

        If unsure, say 'y'

menuconfig QSDK_VERSION
    bool "QSDK Version"
    help "Select QSDK Version"

config PLATFORM_QCA_QSDK110
    bool "QSDK 11.0"

if PLATFORM_QCA_QSDK110
    config PLATFORM_QCA_QSDK11_SUB_VER4
        bool "QSDK 11.4"
endif

config PLATFORM_QCA_QSDK120
    bool "QSDK 12.0"

if PLATFORM_QCA_QSDK120
    config PLATFORM_QCA_QSDK12_SUB_VER1
        bool "QSDK 12.1"
endif

config QSDK_VERSION
    hex
    default 0x1100 if PLATFORM_QCA_QSDK110
    default 0x1200 if PLATFORM_QCA_QSDK120
    default 0

config QCA_TARGET_EXTTOOL_LIST_CHAN_STATE
    bool
    default y if PLATFORM_QCA_QSDK11_SUB_VER4
    default y if PLATFORM_QCA_QSDK120
    default n

config QCA_TARGET_GET_CHANNEL_SURVEY_STATS_VERSION_2
    bool
    default y if PLATFORM_QCA_QSDK11_SUB_VER4
    default y if PLATFORM_QCA_QSDK120
    default n

config QCA_TARGET_PUNCTURING_SUPPORT
    bool
    default y if PLATFORM_QCA_QSDK120
    default n

config QCA_WIFI_DFS_STATE_ENUM_V1
    bool
    default y if PLATFORM_QCA_QSDK11_SUB_VER4
    default n

config QCA_WIFI_DFS_STATE_ENUM_V2
    bool
    default y if PLATFORM_QCA_QSDK120
    default n

config QCA_WIFI_PUNCTURE_SUPPORTED
    bool
    default y if PLATFORM_QCA_QSDK120
    default n

config QCA_WIFI_MODE_NO_RESET_SUPPORTED
    bool
    default y if PLATFORM_QCA_QSDK120
    default n

config QCA_WIFI_NL80211_SUPPORTED
    bool
    default y if PLATFORM_QCA_QSDK110
    default y if PLATFORM_QCA_QSDK120
    default n
    help
        Ever since QSDK11.0 the qcawifi driver started
        supporting nl80211 configuration interface.

        It has its quirks and still requires some vendor
        specific commands and events to be handled over
        NL80211_CMD_VENDOR.

config QCA_USE_SYSUPGRADE
    bool "Use sysupgrade for upgrades"
    default n
    help
        This is a default OpenSync upgrade layer implementation for QCA
        based devices.

config QCA_USE_GRE_NSS
    bool "Use NSS accelerated GRE tunnel"
    default n
    depends on !INET_GRE_USE_GRETAP
    help
        Add support for the NSS GRE (For NSS based QCA platforms only).
        Uses the inet_nssgre_t class as the default GRE implementation.
        This options redefines the inet_gre_new() function to return
        a inet_nssgre_t class.

config QCA_USE_DPP
    bool "Use DPP for WPA Key Management"
    default n
    help
        Add support for WFA Easy Connect (DPP).

config QCA_NF_NAT_HELPERS
    bool "Use preferred OpenSync netfilter NAT helpers"
    default y
    help
        This will overwrite /etc/modules.d/nf-nathelper-extra
        with preferred OpenSync options.

config QCA_HW_ACC_FLUSH_MAC_FILE
    string "Hardware acceleration per-MAC flush file path"
    default "/sys/kernel/debug/ecm/ecm_db/defunct_mac"
    help
        This is the file where MAC addresses of Openflow rules
        are stored for flushing.

config QCA_HW_ACC_FLUSH_ALL_FILE
    string "Hardware acceleration flush ALL entries file path"
    default "/sys/kernel/debug/ecm/ecm_db/defunct_all"
    help
        This is the file using which ALL acceleration entries can
        be flushed.

config QCA_HW_ACC_NSS
    bool "Enable NSS acceleration support"
    default n
    help
        Enable NSS acceleration support

endif
```

## src/lib/osn/kconfig/Kconfig.osn.igmp_backend
```kconfig
config OSN_BACKEND_IGMP_QCA
    bool "QCA mcproxy"

    select OSN_LINUX_ENABLED
    help
        Use the Qualcomm `mcproxy` utility for managing IGMP.

        Qualcomm platforms use mcproxy binary for correctly configuring up IGMP
        traffic.
```

## src/lib/osn/kconfig/Kconfig.osn.mld_backend
```kconfig
config OSN_BACKEND_MLD_QCA
    bool "QCA mcproxy"

    select OSN_LINUX_ENABLED
    help
        Use the Qualcomm `mcproxy` utility for managing MLD.

        Qualcomm platforms use mcproxy binary for correctly configuring up MLD
        traffic.
```

## src/lib/osp/kconfig/Kconfig.osp_l2switch.backend
```kconfig
config OSP_L2SWITCH_SSDKSH
    bool "ssdk_sh"
    help
        Use the `ssdk_sh` tool for L2 switch configuration
```
